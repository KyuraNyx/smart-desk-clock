/* ====================================================================
 * Project     : Smart Desk Clock & Environmental Monitor (IoT)
 * Platform    : ESP32-C3 Mini
 * 
 * Contributors:
 * - Hayqal Husein Alhabsyi
 * - Muhammad Raihan Aqeela Akbar
 * - Muhammad Minanur Rohman
 * - Muhammad Zaki Firmansyah
 * - Made Nugraha Pradnyana
 * ==================================================================== */

#include <WiFi.h>
#include <WiFiUdp.h>
#include <WiFiManager.h>
#include <NTPClient.h>
#include <DHT.h>
#include <Adafruit_GFX.h>
#include <Adafruit_SH110X.h>
#include <FluxGarage_RoboEyes.h>

// =========================
// PIN & SENSOR
// =========================
#define DHTPIN 7
#define DHTTYPE DHT11
#define MQ135PIN 0
#define OLED_RESET -1

WiFiUDP ntpUDP;
NTPClient timeClient(ntpUDP, "pool.ntp.org", 7 * 3600, 60000); // GMT+7

// =========================
// OLED & SENSOR OBJECTS
// =========================
Adafruit_SH1106G display(128, 64, &Wire, OLED_RESET);
DHT dht(DHTPIN, DHTTYPE);
roboEyes eyes;

// =========================
// STATE MACHINE
// =========================
enum State {
  MODE_CLOCK,
  MODE_TEMP,
  MODE_HUMID,
  MODE_AIR,
  MODE_ANIMATION
};

State currentState = MODE_CLOCK;

// Durasi masing-masing mode
const unsigned long D_CLOCK = 20000;
const unsigned long D_TEMP  = 3000;
const unsigned long D_HUMID = 3000;
const unsigned long D_AIR   = 3000;
const unsigned long D_ANIM  = 4000;

unsigned long lastSwitch = 0;

// =========================
// Bitmap
// =========================
const unsigned char icon_temp [] PROGMEM = {
 0x00, 0x00, 0x00, 0x00, 0x00, 0x00, 0x00, 0x00, 0x00, 0x00,
0x00, 0x00, 0x00, 0x00, 0x00, 0x00, 0x00, 0x00, 0x00, 0x00,
0x00, 0x00, 0x00, 0x00, 0x00, 0x00, 0x00, 0x00, 0x00, 0x00,
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0x00, 0x00, 0x00, 0x00, 0x00, 0x00, 0x00, 0x00, 0x00, 0x00};
const unsigned char icon_humid [] PROGMEM = {
0x00, 0x00, 0x00, 0x00, 0x00, 0x00, 0x00, 0x00, 0x00, 0x00,
0x00, 0x00, 0x00, 0x00, 0x00, 0x00, 0x00, 0x00, 0x00, 0x00,
0x00, 0x00, 0x00, 0x00, 0x00, 0x00, 0x00, 0x00, 0x00, 0x00,
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0x00, 0x00, 0x00, 0x00, 0x00, 0x00, 0x00, 0x00, 0x00, 0x00};
const unsigned char icon_air [] PROGMEM = {
0x00, 0x00, 0x00, 0x00, 0x00, 0x00, 0x00, 0x00, 0x00, 0x84,
0x02, 0x00, 0x00, 0x00, 0x01, 0x00, 0x00, 0x00, 0x01, 0x00,
0x00, 0x00, 0x0C, 0x00, 0x02, 0x01, 0x18, 0x00, 0x01, 0x18,
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0x00, 0x00, 0x00, 0x00, 0x00, 0x07, 0xF8, 0x00, 0x00, 0x00};

// =========================
// Setup
// =========================
void setup() {
  Serial.begin(115200);
  delay(100);
  // WiFi
  WiFiManager wm;
  wm.setTimeout(180); // Timeout 180 detik (3 menit), jika tidak ada koneksi maka reboot

  if (!wm.autoConnect("Smart Desk Clock")) {
    Serial.println("Failed to connect. Rebooting...");
    delay(3000);
    ESP.restart();
  }
  Serial.println("\nWiFi connected");
  Serial.println(WiFi.localIP());

  // NTP
  timeClient.begin();

  // OLED
  if (!display.begin(0x3C, true)) {
    Serial.println("OLED init failed!");
    while (1);
  }

  display.clearDisplay();

  // Sensor
  dht.begin();

  // Eyes
  eyes.begin(128, 64, 100);
  eyes.setPosition(DEFAULT);

  lastSwitch = millis();
}

// =========================
// MAIN LOOP
// =========================
void loop() {
  unsigned long now = millis();

  switch (currentState) {
    case MODE_CLOCK:
      showClock();
      if (now - lastSwitch >= D_CLOCK) {
        switchTo(MODE_ANIMATION);
      }
      break;

    case MODE_TEMP:
      showTemperature();
      if (now - lastSwitch >= D_TEMP) {
        switchTo(MODE_ANIMATION);
      }
      break;

    case MODE_HUMID:
      showHumidity();
      if (now - lastSwitch >= D_HUMID) {
        switchTo(MODE_ANIMATION);
      }
      break;

    case MODE_AIR:
      showAirQuality();
      if (now - lastSwitch >= D_AIR) {
        switchTo(MODE_ANIMATION);
      }
      break;

    case MODE_ANIMATION:
      playEyeAnimation();
      if (now - lastSwitch >= D_ANIM) {
        nextModeAfterAnimation();
      }
      break;
  }
}

// =========================
// Mode Switch Helper
// =========================
void switchTo(State next) {
  currentState = next;
  lastSwitch = millis();
  if (next == MODE_ANIMATION) resetAnimation();
}

void nextModeAfterAnimation() {
  switch (currentState) {

    case MODE_ANIMATION:
      // Tentukan urutan siklus
      static int stage = 0;

      stage++;
      if (stage > 3) stage = 0;

      if (stage == 0)      switchTo(MODE_CLOCK);
      else if (stage == 1) switchTo(MODE_TEMP);
      else if (stage == 2) switchTo(MODE_HUMID);
      else if (stage == 3) switchTo(MODE_AIR);

      break;
  }
}

// =========================
// CLOCK DISPLAY
// =========================
void showClock() {
  timeClient.update();

  time_t epoch = timeClient.getEpochTime();
  struct tm* tmInfo = gmtime((time_t*)&epoch);

  int h = tmInfo->tm_hour;
  int m = tmInfo->tm_min;
  int s = tmInfo->tm_sec;

  String day[7] = {"Sun","Mon","Tue","Wed","Thu","Fri","Sat"};
  String mon[12] = {"Jan","Feb","Mar","Apr","May","Jun","Jul",
                    "Aug","Sep","Oct","Nov","Dec"};

  display.clearDisplay();
  display.setTextColor(SH110X_WHITE);

  // Judul
  display.setTextSize(1);
  display.setCursor(10, 5);
  display.println("SMART DESK CLOCK");

  // Jam
  display.setTextSize(2);
  display.setCursor(20, 22);
  display.printf("%02d:%02d:%02d", h, m, s);

  // Tanggal
  display.setTextSize(1);
  display.setCursor(6, 54);
  display.printf("%s %02d %s %04d",
      day[tmInfo->tm_wday].c_str(),
      tmInfo->tm_mday,
      mon[tmInfo->tm_mon].c_str(),
      tmInfo->tm_year + 1900
  );

  drawBorder();
  display.display();
}


// =========================
// TEMP DISPLAY
// =========================
void showTemperature() {
  float t = dht.readTemperature();

  display.clearDisplay();
  display.setTextColor(SH110X_WHITE);

  display.setTextSize(1);
  display.setCursor(6, 5);
  display.println("Temperature");

  display.setTextSize(2);
  display.setCursor(10, 28);   // geser dari 0 -> 10
  display.printf("%.1f C", t);

  display.drawBitmap(75, 10, icon_temp, 50, 50, SH110X_WHITE);

  drawBorder();
  display.display();
}


// =========================
// HUMID DISPLAY
// =========================
void showHumidity() {
  float h = dht.readHumidity();

  display.clearDisplay();
  display.setTextColor(SH110X_WHITE);

  display.setTextSize(1);
  display.setCursor(6, 5);
  display.println("Humidity");

  display.setTextSize(2);
  display.setCursor(10, 28);
  display.printf("%.1f%%", h);

  display.drawBitmap(75, 10, icon_humid, 50, 50, SH110X_WHITE);

  drawBorder();
  display.display();
}


// =========================
// AQI DISPLAY (ANALOG MQ135)
// =========================
void showAirQuality() {
  int analogValue = analogRead(MQ135PIN);

  String status =
    (analogValue < 200) ? "Good" :
    (analogValue < 400) ? "Moderate" :
                          "Bad";

  display.clearDisplay();
  display.setTextColor(SH110X_WHITE);

  display.setTextSize(1);
  display.setCursor(6, 5);
  display.println("Air Quality");

  display.setTextSize(2);
  display.setCursor(10, 26);
  display.printf("%d", analogValue);

  display.setTextSize(1);
  display.setCursor(10, 50);
  display.printf("(%s)", status.c_str());

  display.drawBitmap(75, 10, icon_air, 50, 50, SH110X_WHITE);

  drawBorder();
  display.display();
}



// =========================
// ANIMATION
// =========================
unsigned long lastAnim = 0;
int animStep = 0;

void playEyeAnimation() {
  unsigned long now = millis();

  if (now - lastAnim >= 1200) {
    lastAnim = now;

    if (animStep == 0) eyes.setMood(HAPPY);
    else if (animStep == 1) eyes.setMood(TIRED);
    else if (animStep == 2) eyes.setMood(DEFAULT);

    animStep++;
    if (animStep > 2) animStep = 0;
  }

  eyes.update();
}

void drawBorder() {
  // Border luar (tebal 3 pixel)
  for (int i = 0; i < 3; i++) {
    display.drawRect(i, i, 128 - 2*i, 64 - 2*i, SH110X_WHITE);
  }
}


void resetAnimation() {
  animStep = 0;
  lastAnim = millis();
}